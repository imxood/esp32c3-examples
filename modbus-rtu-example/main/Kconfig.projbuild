## modbus-rtu-example/main/Kconfig.projbuild
```kconfig
menu "Example Configuration"

    choice BLINK_LED
        prompt "Blink LED type"
        default BLINK_LED_GPIO if IDF_TARGET_ESP32
        default BLINK_LED_RMT
        help
            Defines the default peripheral for blink example

        config BLINK_LED_GPIO
            bool "GPIO"
        config BLINK_LED_RMT
            bool "RMT - Addressable LED"
    endchoice

    config BLINK_LED_RMT_CHANNEL
        depends on BLINK_LED_RMT
        int "RMT Channel"
        range 0 7
        default 0
        help
            Set the RMT peripheral channel.
            ESP32 RMT channel from 0 to 7
            ESP32-S2 RMT channel from 0 to 3
            ESP32-S3 RMT channel from 0 to 3
            ESP32-C3 RMT channel from 0 to 1

    config BLINK_GPIO
        int "Blink GPIO number"
        range 0 48
        default 8 if IDF_TARGET_ESP32C3 || IDF_TARGET_ESP32H2
        default 18 if IDF_TARGET_ESP32S2
        default 48 if IDF_TARGET_ESP32S3
        default 5
        help
            GPIO number (IOxx) to blink on and off or the RMT signal for the addressable LED.
            Some GPIOs are used for other purposes (flash connections, etc.) and cannot be used to blink.

    config BLINK_PERIOD
        int "Blink period in ms"
        range 10 3600000
        default 1000
        help
            Define the blinking period in milliseconds.


    config MB_UART_PORT_NUM
        int "UART port number"
        range 0 2 if IDF_TARGET_ESP32
        default 2 if IDF_TARGET_ESP32
        range 0 1 if IDF_TARGET_ESP32S2
        default 1 if IDF_TARGET_ESP32S2
        range 0 1 if IDF_TARGET_ESP32C3
        default 1 if IDF_TARGET_ESP32C3
        help
            UART communication port number for Modbus example.

    config MB_UART_BAUD_RATE
        int "UART communication speed"
        range 1200 115200
        default 115200
        help
            UART communication speed for Modbus example.

    config MB_UART_RXD
        int "UART RXD pin number"
        range 0 34 if IDF_TARGET_ESP32
        default 22 if IDF_TARGET_ESP32
        range 0 46 if IDF_TARGET_ESP32S2
        default 19 if IDF_TARGET_ESP32S2
        range 0 34 if IDF_TARGET_ESP32C3
        default 5 if IDF_TARGET_ESP32C3
        help
            GPIO number for UART RX pin. See UART documentation for more information
            about available pin numbers for UART.

    config MB_UART_TXD
        int "UART TXD pin number"
        range 0 34 if IDF_TARGET_ESP32
        default 23 if IDF_TARGET_ESP32
        range 0 46 if IDF_TARGET_ESP32S2
        default 20 if IDF_TARGET_ESP32S2
        range 0 34 if IDF_TARGET_ESP32C3
        default  4 if IDF_TARGET_ESP32C3
        help
            GPIO number for UART TX pin. See UART documentation for more information
            about available pin numbers for UART.

    config MB_UART_RTS
        int "UART RTS pin number"
        range 0 34 if IDF_TARGET_ESP32
        range 0 46 if IDF_TARGET_ESP32S2
        range 0 34 if IDF_TARGET_ESP32C3
        default 18
        help
            GPIO number for UART RTS pin. This pin is connected to
            ~RE/DE pin of RS485 transceiver to switch direction.
            See UART documentation for more information about available pin
            numbers for UART.

    choice MB_COMM_MODE
        prompt "Modbus communication mode"
        default MB_COMM_MODE_RTU if CONFIG_FMB_COMM_MODE_RTU_EN
        help
            Selection of Modbus communication mode option for Modbus.

        config MB_COMM_MODE_RTU
            bool "RTU mode"
            depends on FMB_COMM_MODE_RTU_EN

        config MB_COMM_MODE_ASCII
            bool "ASCII mode"
            depends on FMB_COMM_MODE_ASCII_EN

    endchoice

    config MB_SLAVE_ADDR
        int "Modbus slave address"
        range 1 127
        default 1
        help
            This is the Modbus slave address in the network.
            It is used to organize Modbus network with several slaves connected into the same segment.

endmenu
```

## modbus-rtu-example/sdkconfig.defaults
```kconfig
#
# Modbus configuration
#
CONFIG_MB_UART_PORT_NUM=1
CONFIG_MB_UART_BAUD_RATE=115200
CONFIG_MB_UART_RXD=5
CONFIG_MB_UART_TXD=4
CONFIG_MB_UART_RTS=18
CONFIG_MB_COMM_MODE_RTU=y
CONFIG_MB_SLAVE_ADDR=1

CONFIG_MB_COMM_MODE_RTU=y

CONFIG_FMB_TIMER_PORT_ENABLED=y
CONFIG_FMB_TIMER_GROUP=0
CONFIG_FMB_TIMER_INDEX=0
CONFIG_FMB_TIMER_ISR_IN_IRAM=y
```
